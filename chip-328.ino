#include "chip328lib.h"
#include "ssd1306.h"

unsigned long current = 0, dtMillis = 0;

uint8_t chip328Display[256];

uint8_t interfacePutPixel(uint8_t x, uint8_t y, uint8_t pixel){
  uint8_t collision = 0;
  uint8_t pos;

  if(pixel){
    pos = ((x+(y/8)*64));

    if(chip328Display[pos]&(0b00000001<<(y%8))) collision = 1;
    chip328Display[pos] = chip328Display[pos]^(0b00000001<<(y%8));

  }

  uint8_t original = chip328Display[x+(y/8)*64];
  uint8_t expandedUp = 0b00000000, expandedDown = 0b00000000;

  expandedUp = expandedUp | (original&0b00010000)>>4;
  expandedUp = expandedUp | (original&0b00010000)>>3;
  expandedUp = expandedUp | (original&0b00100000)>>3;
  expandedUp = expandedUp | (original&0b00100000)>>2;
  expandedUp = expandedUp | (original&0b01000000)>>2;
  expandedUp = expandedUp | (original&0b01000000)>>1;
  expandedUp = expandedUp | (original&0b10000000)>>1;
  expandedUp = expandedUp | (original&0b10000000);

  expandedDown = expandedDown | (original&0b00000001);
  expandedDown = expandedDown | (original&0b00000001)<<1;
  expandedDown = expandedDown | (original&0b00000010)<<1;
  expandedDown = expandedDown | (original&0b00000010)<<2;
  expandedDown = expandedDown | (original&0b00000100)<<2;
  expandedDown = expandedDown | (original&0b00000100)<<3;
  expandedDown = expandedDown | (original&0b00001000)<<3;
  expandedDown = expandedDown | (original&0b00001000)<<4;

  //O MSB do display é o LSB do buffer...
  ssd1306_putPixels(x*2, ((y/8)*8)*2, expandedDown);
  ssd1306_putPixels(x*2+1, ((y/8)*8)*2, expandedDown);

  ssd1306_putPixels(x*2, ((y/8)*8)*2+8, expandedUp);
  ssd1306_putPixels(x*2+1, ((y/8)*8)*2+8, expandedUp);

  return collision;
}

void interfaceDelayTimer(int value){
  //if(DT!=0) DT--;
  //glutTimerFunc(17, interfaceDelayTimer, 0);
}

void interfaceLoadROM(){
  int i;
  const PROGMEM uint8_t brix[280] = {0x6E, 0x05, 0x65, 0x00, 0x6B, 0x06, 0x6A, 0x00, 0xA3, 0x0C, 0xDA, 0xB1, 0x7A,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 0x00, 0x00};
  for(i=0;i<280;i++){
    chip328MemoryWrite(i+512, brix[i]);
  }
}

void setup() {
    Serial.begin(9600);
    Serial.println("Setup");
    interfaceLoadROM();
    chip328Begin();
    ssd1306_128x64_i2c_init();
    ssd1306_fillScreen( 0x00 );
    Serial.println("End of setup");
}

void loop() {
    chip328Emulate();
    DT = 0;
}
